VERSION ""

NS_ :

BS_:

BU_: NOONE SENSOR DRIVER MOTOR GPS IO

BO_ 0xA0 HEARTBEAT: 1 DRIVER
 SG_ DRIVER_HEARTBEAT_cmd : 0|8@1+ (1,0) [0|0] "" SENSOR,MOTOR,GPS

BO_ 0x18b COORDINATES: 1 GPS
 SG_ GPS_LAT1 : 0|8@1+ (1,0) [0|0] "" DRIVER,IO,MOTOR
 SG_ GPS_LAT2 : 8|8@1+ (1,0) [0|0] "" DRIVER,IO,MOTOR
 SG_ GPS_LONG1 : 16|8@1+ (1,0) [0|0] "" DRIVER,IO,MOTOR
 SG_ GPS_LONG2 : 24|8@1+ (1,0) [0|0] "" DRIVER,IO,MOTOR
 SG_ CHKPT_DIST : 32|8@1+ (1,0) [0|0] "" DRIVER,IO,MOTOR
 SG_ REACHED_FLAG : 40|8@1+ (1,0) [0|0] "" DRIVER,IO,MOTOR
 SG_ HEADING_CURR : 48|8@1+ (1,0) [0|0] "" DRIVER,IO,MOTOR
 SG_ HEADING_DESIRED : 56|8@1+ (1,0) [0|0] "" DRIVER,IO,MOTOR

BO_ 0x119 CHECKPOINTS: 1 MASTER
 SG_ CHKP_LAT1 : 0|8@1+ (1,0) [0|0] "" GPS,IO
 SG_ CHKP_LAT2 : 8|8@1+ (1,0) [0|0] "" GPS,IO
 SG_ CHKP_LONG1 : 16|8@1+ (1,0) [0|0] "" GPS,IO
 SG_ CHKP_LONG2 : 24|8@1+ (1,0) [0|0] "" GPS,IO
 SG_ CHKP_COUNT : 32|8@1+ (1,0) [0|0] "" GPS,IO

BO_ 200 SONARS: 6 SENSOR
 SG_ SENSOR_SONARS_mux M : 0|4@1+ (1,0) [0|0] "" DRIVER,IO
 SG_ SENSOR_SONARS_s1_fault : 4|1@1+ (1,0) [0|0] "" DRIVER,IO
 SG_ SENSOR_SONARS_s2_fault : 5|1@1+ (1,0) [0|0] "" DRIVER,IO
 SG_ SENSOR_SONARS_s3_fault : 6|1@1+ (1,0) [0|0] "" DRIVER,IO
 SG_ SENSOR_SONARS_s4_fault : 7|1@1+ (1,0) [0|0] "" DRIVER,IO
 SG_ SENSOR_SONARS_left m0 : 8|12@1+ (0.1,0) [0|400] "" DRIVER,IO
 SG_ SENSOR_SONARS_middle m0 : 20|12@1+ (0.1,0) [0|0] "" DRIVER,IO
 SG_ SENSOR_SONARS_right m0 : 32|12@1+ (0.1,0) [0|0] "" DRIVER,IO
 SG_ SENSOR_SONARS_rear m0 : 44|12@1+ (0.1,0) [0|0] "" DRIVER,IO
 SG_ SENSOR_SONARS_no_filt_left m1 : 8|12@1+ (0.1,0) [0|400] "" NOONE
 SG_ SENSOR_SONARS_no_filt_middle m1 : 20|12@1+ (0.1,0) [0|400] "" NOONE
 SG_ SENSOR_SONARS_no_filt_right m1 : 32|12@1+ (0.1,0) [0|400] "" NOONE
 SG_ SENSOR_SONARS_no_filt_rear m1 : 44|12@1+ (0.1,0) [0|400] "" NOONE

BO_ 0X020 MOTOR_CMD: 1 DRIVER
 SG_ MOTOR_CMD_steer : 0|4@1- (1,-5) [-5|5] "" MOTOR
 SG_ MOTOR_CMD_drive : 4|4@1+ (1,0) [0|9] "" MOTOR

CM_ BU_ NOONE "No node, used to indicate if it's a debug message going to no one";
CM_ BU_ DRIVER "The DRIVER controller driving the car";
CM_ BU_ SENSOR "The sensor controller of the car";
CM_ BU_ MOTOR "The motor controller of the car";
CM_ BO_ 0xA0 "Sync message used to synchronize the controllers";

BA_DEF_  "BusType" STRING ;
BA_DEF_ SG_ "FieldType" STRING ;
BA_DEF_ BO_ "GenMsgCycleTime" INT 0 0;

BA_DEF_DEF_ "BusType" "CAN";
BA_DEF_DEF_ "FieldType" "";

BA_ "GenMsgCycleTime" BO_ 0xA0 1000;
BA_ "GenMsgCycleTime" BO_ 0x01 100;
BA_ "GenMsgCycleTime" BO_ 0X020 100;
BA_ "FieldType" SG_ 0xA0 DRIVER_HEARTBEAT_cmd "DRIVER_HEARTBEAT_cmd";

VAL_ 0xA0 DRIVER_HEARTBEAT_cmd 0 "DRIVER_HEARTBEAT_cmd_NOOP" 1 "DRIVER_HEARTBEAT_cmd_SYNC" 2 "DRIVER_HEARTBEAT_cmd_REBOOT";
